## Documentation/devicetree/bindings/soc/google/google,mbu-cpm.yaml
```yaml
# SPDX-License-Identifier: (GPL-2.0-only OR BSD-2-Clause)
%YAML 1.2
---
$id: http://devicetree.org/schemas/soc/google/google,mbu-cpm.yaml#
$schema: http://devicetree.org/meta-schemas/core.yaml#

title: Google Tensor G6 Central Power Manager

maintainers:
  - Witold Olechowski <witusio@gmail.com>

description:
  The Central Power Manager (CPM) is a microcontroller in the Google Tensor
  G6 (malibu) SoC that owns most of its clocks, power domains and resets.
  The AP talks to it through two queued mailboxes of a Google MailBox Array,
  one for requests and one for responses and notifications.

  Clocks are identified by the id of their subsystem clock manager (LPCM)
  and their id within that LPCM, see
  include/dt-bindings/clock/google,mbu-cpm.h. Resets are identified the same
  way, see include/dt-bindings/reset/google,mbu-cpm.h. Power domains are
  listed in include/dt-bindings/power/google,mbu-power.h.

properties:
  compatible:
    const: google,mbu-cpm

  mboxes:
    items:
      - description: request mailbox
      - description: response and notification mailbox

  mbox-names:
    items:
      - const: tx
      - const: rx

  '#clock-cells':
    const: 2

  '#power-domain-cells':
    const: 1

  '#reset-cells':
    const: 2

  pmic-regulators:
    type: object
    additionalProperties: false
    description:
      Regulators of the DA9188 ("m") and DA9189 ("s") AP PMICs, which sit on
      a bus owned by the CPM.

    properties:
      compatible:
        const: google,mbu-pmic-regulators

      regulators:
        type: object
        additionalProperties: false

        patternProperties:
          '^(buck_([1-9]|1[0-3])|ldo_([1-9]|1[0-9]|2[0-8]))[ms]$':
            type: object
            $ref: /schemas/regulator/regulator.yaml#
            unevaluatedProperties: false

        properties:
          buck_boost:
            type: object
            $ref: /schemas/regulator/regulator.yaml#
            unevaluatedProperties: false

    required:
      - compatible
      - regulators

  gpio:
    type: object
    additionalProperties: false
    description: GPIOs of the DA9188 and DA9189 AP PMICs.

    properties:
      compatible:
        const: google,mbu-pmic-gpio

      gpio-controller: true

      '#gpio-cells':
        const: 2

      ngpios:
        maximum: 32

      gpio-line-names: true

    required:
      - compatible
      - gpio-controller
      - '#gpio-cells'
      - ngpios

required:
  - compatible
  - mboxes
  - mbox-names
  - '#clock-cells'
  - '#power-domain-cells'
  - '#reset-cells'

additionalProperties: false

examples:
  - |
    power-management {
        compatible = "google,mbu-cpm";
        mboxes = <&cpm_req_mbox>, <&cpm_resp_mbox>;
        mbox-names = "tx", "rx";
        #clock-cells = <2>;
        #power-domain-cells = <1>;
        #reset-cells = <2>;

        pmic-regulators {
            compatible = "google,mbu-pmic-regulators";

            regulators {
                ldo_18s {
                    regulator-name = "ldo_18s";
                    regulator-min-microvolt = <1500000>;
                    regulator-max-microvolt = <3400000>;
                };
            };
        };

        gpio {
            compatible = "google,mbu-pmic-gpio";
            gpio-controller;
            #gpio-cells = <2>;
            ngpios = <19>;
        };
    };
```

## Documentation/devicetree/bindings/watchdog/google,mbu-wdt.yaml
```yaml
# SPDX-License-Identifier: (GPL-2.0-only OR BSD-2-Clause)
%YAML 1.2
---
$id: http://devicetree.org/schemas/watchdog/google,mbu-wdt.yaml#
$schema: http://devicetree.org/meta-schemas/core.yaml#

title: Google Tensor G6 watchdog timer

maintainers:
  - Witold Olechowski <witusio@gmail.com>

description:
  Watchdog timer of the Google Tensor G6 (malibu) SoC, a down counter
  clocked by the always-on oscillator. On expiry it either interrupts the
  AP, which traps to EL3 to collect CPU state, or signals the GDMC
  microcontroller, which resets the system.

allOf:
  - $ref: watchdog.yaml#

properties:
  compatible:
    const: google,mbu-wdt

  reg:
    maxItems: 1

  clocks:
    maxItems: 1

  google,expire-to-gdmc:
    type: boolean
    description:
      Route the expiry to the GDMC, which resets the system, instead of to
      the AP.

required:
  - compatible
  - reg
  - clocks

unevaluatedProperties: false

examples:
  - |
    watchdog@200c5000 {
        compatible = "google,mbu-wdt";
        reg = <0x200c5000 0x1000>;
        clocks = <&osc>;
        timeout-sec = <30>;
        google,expire-to-gdmc;
    };
```

## drivers/clk/google/Kconfig
```kconfig
# SPDX-License-Identifier: GPL-2.0-only

config COMMON_CLK_GOOGLE_CPM
	tristate "Google Tensor CPM clock driver"
	depends on GOOGLE_CPM
	default GOOGLE_CPM
	help
	  Clock driver for the clocks managed by the Central Power Manager
	  (CPM) of Google Tensor SoCs.
```

## drivers/gpu/drm/google/Kconfig
```kconfig
# SPDX-License-Identifier: GPL-2.0-only

config DRM_GOOGLE_MBU_DSI
	tristate "Google Tensor G6 MIPI DSI"
	depends on DRM && OF
	depends on ARCH_GOOGLE || COMPILE_TEST
	select DRM_DW_MIPI_DSI2
	select GENERIC_PHY_MIPI_DPHY
	help
	  Glue for the Synopsys DesignWare MIPI DSI-2 host controllers of the
	  Google Tensor G6 (malibu) SoC.

config DRM_GOOGLE_MBU_DPU
	tristate "Google Tensor G6 display controller"
	depends on DRM_GOOGLE_MBU_DSI
	select DRM_CLIENT_SELECTION
	select DRM_GEM_DMA_HELPER
	select DRM_KMS_HELPER
	select DRM_BRIDGE
	select DRM_PANEL_BRIDGE
	help
	  Driver for the VeriSilicon DC9400 display processing unit of the
	  Google Tensor G6 (malibu) SoC. It drives one layer on the built-in
	  command mode DSI panel, with Display Stream Compression.
```

## drivers/pinctrl/google/Kconfig
```kconfig
# SPDX-License-Identifier: GPL-2.0-only

config PINCTRL_GOOGLE
	bool
	select GENERIC_PINCONF
	select GENERIC_PINMUX_FUNCTIONS
	select GPIOLIB
	select GPIOLIB_IRQCHIP
	select PINMUX

config PINCTRL_GOOGLE_MBU
	bool "Google Tensor G6 (malibu) pin controller"
	depends on ARCH_GOOGLE || COMPILE_TEST
	depends on OF
	default ARCH_GOOGLE
	select PINCTRL_GOOGLE
	help
	  Pin controller and GPIO driver for the Google Tensor G6 SoC
	  (malibu), found in the Pixel 11 family.
```

## drivers/pmdomain/google/Kconfig
```kconfig
# SPDX-License-Identifier: GPL-2.0-only

config GOOGLE_MBU_PM_DOMAINS
	tristate "Google Tensor G6 power domains"
	depends on GOOGLE_CPM && PM
	select PM_GENERIC_DOMAINS
	default GOOGLE_CPM
	help
	  Power domain driver for the Google Tensor G6 (malibu) SoC. The
	  domains are managed by the Central Power Manager (CPM).
```

## drivers/soc/google/Kconfig
```kconfig
# SPDX-License-Identifier: GPL-2.0-only

config GOOGLE_CPM
	tristate "Google Tensor Central Power Manager interface"
	depends on ARCH_GOOGLE || COMPILE_TEST
	depends on MAILBOX && OF
	select AUXILIARY_BUS
	imply GOOG_MBA_MBOX
	default ARCH_GOOGLE
	help
	  Interface to the Central Power Manager (CPM) of Google Tensor SoCs
	  starting with Tensor G6 (malibu). The CPM owns most clocks and
	  power domains of the SoC, and this driver provides the mailbox
	  protocol used by the CPM clock and power domain drivers.
```
