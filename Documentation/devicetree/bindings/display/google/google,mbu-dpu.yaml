## Documentation/devicetree/bindings/display/google/google,mbu-dpu.yaml
```yaml
# SPDX-License-Identifier: (GPL-2.0-only OR BSD-2-Clause)
%YAML 1.2
---
$id: http://devicetree.org/schemas/display/google/google,mbu-dpu.yaml#
$schema: http://devicetree.org/meta-schemas/core.yaml#

title: Google Tensor G6 display controller

maintainers:
  - Witold Olechowski <witusio@gmail.com>

description:
  The display processing unit of the Google Tensor G6 (malibu) SoC is a
  VeriSilicon DC9400. It fetches layers from memory, blends them and sends
  the result, optionally compressed with DSC, to the MIPI DSI hosts or the
  DisplayPort controller.

properties:
  compatible:
    const: google,mbu-dpu

  reg:
    maxItems: 1

  interrupts:
    items:
      - description: Output 0 frame done
      - description: Output 0 underrun

  interrupt-names:
    items:
      - const: frame-done
      - const: underrun

  power-domains:
    minItems: 1
    maxItems: 4

  iommus:
    minItems: 1
    maxItems: 32

  port:
    $ref: /schemas/graph.yaml#/properties/port
    description: Output 0, connected to the DSI0 host.

required:
  - compatible
  - reg
  - interrupts
  - interrupt-names
  - power-domains
  - port

additionalProperties: false

examples:
  - |
    display-controller@f600000 {
        compatible = "google,mbu-dpu";
        reg = <0x0f600000 0x11f000>;
        interrupts-extended = <&dpu_multicast_aggr_1 5>,
                              <&dpu_multicast_aggr_1 6>;
        interrupt-names = "frame-done", "underrun";
        power-domains = <&cpm 5>, <&cpm 6>, <&cpm 8>;

        port {
            dpu_out_dsi0: endpoint {
                remote-endpoint = <&dsi0_in>;
            };
        };
    };
```

## Documentation/devicetree/bindings/display/google/google,mbu-mipi-dsi.yaml
```yaml
# SPDX-License-Identifier: (GPL-2.0-only OR BSD-2-Clause)
%YAML 1.2
---
$id: http://devicetree.org/schemas/display/google/google,mbu-mipi-dsi.yaml#
$schema: http://devicetree.org/meta-schemas/core.yaml#

title: Google Tensor G6 MIPI DSI controller

maintainers:
  - Witold Olechowski <witusio@gmail.com>

description:
  The Google Tensor G6 (malibu) SoC has two Synopsys DesignWare MIPI DSI-2
  host controllers, each paired with a Synopsys C/D-PHY used in D-PHY mode.

properties:
  compatible:
    const: google,mbu-mipi-dsi

  reg:
    maxItems: 1

  interrupts:
    maxItems: 1

  clocks:
    maxItems: 2

  clock-names:
    items:
      - const: pclk
      - const: sys

  phys:
    maxItems: 1

  phy-names:
    const: dphy

  power-domains:
    maxItems: 1

  ports:
    $ref: /schemas/graph.yaml#/properties/ports

    properties:
      port@0:
        $ref: /schemas/graph.yaml#/properties/port
        description: Input from the display controller.

      port@1:
        $ref: /schemas/graph.yaml#/properties/port
        description: Output to the panel or bridge.

    required:
      - port@0
      - port@1

required:
  - compatible
  - reg
  - clocks
  - clock-names
  - phys
  - phy-names
  - ports

allOf:
  - $ref: /schemas/display/dsi-controller.yaml#

unevaluatedProperties: false

examples:
  - |
    dsi@f7d8000 {
        compatible = "google,mbu-mipi-dsi";
        reg = <0x0f7d8000 0x800>;
        clocks = <&dsi_pclk>, <&dsi_sys_clk>;
        clock-names = "pclk", "sys";
        phys = <&dsi0_phy>;
        phy-names = "dphy";
        #address-cells = <1>;
        #size-cells = <0>;

        ports {
            #address-cells = <1>;
            #size-cells = <0>;

            port@0 {
                reg = <0>;
                dsi0_in: endpoint {
                    remote-endpoint = <&dpu_out_dsi0>;
                };
            };

            port@1 {
                reg = <1>;
                dsi0_out: endpoint {
                    remote-endpoint = <&panel_in>;
                };
            };
        };
    };
```

## Documentation/devicetree/bindings/display/panel/google,dcsda.yaml
```yaml
# SPDX-License-Identifier: (GPL-2.0-only OR BSD-2-Clause)
%YAML 1.2
---
$id: http://devicetree.org/schemas/display/panel/google,dcsda.yaml#
$schema: http://devicetree.org/meta-schemas/core.yaml#

title: Google dcsda 1080x2424 AMOLED DSI panel

maintainers:
  - Witold Olechowski <witusio@gmail.com>

description:
  Command mode AMOLED panel with DSC compression over four MIPI DSI lanes,
  used in the Pixel 11 family.

allOf:
  - $ref: panel-common.yaml#

properties:
  compatible:
    const: google,dcsda

  reg:
    maxItems: 1

  reset-gpios: true

  vddi-supply:
    description: I/O supply

  vci-supply:
    description: Analog supply

  vddd-supply:
    description: Digital core supply

  port: true

required:
  - compatible
  - reg
  - reset-gpios
  - vddi-supply
  - vci-supply
  - vddd-supply
  - port

unevaluatedProperties: false

examples:
  - |
    #include <dt-bindings/gpio/gpio.h>

    dsi {
        #address-cells = <1>;
        #size-cells = <0>;

        panel@0 {
            compatible = "google,dcsda";
            reg = <0>;
            reset-gpios = <&pmic_gpio 3 GPIO_ACTIVE_LOW>;
            vddi-supply = <&vddi>;
            vci-supply = <&vci>;
            vddd-supply = <&vddd>;

            port {
                panel_in: endpoint {
                    remote-endpoint = <&dsi0_out>;
                };
            };
        };
    };
```

## Documentation/devicetree/bindings/input/touchscreen/syna,s3908.yaml
```yaml
# SPDX-License-Identifier: (GPL-2.0-only OR BSD-2-Clause)
%YAML 1.2
---
$id: http://devicetree.org/schemas/input/touchscreen/syna,s3908.yaml#
$schema: http://devicetree.org/meta-schemas/core.yaml#

title: Synaptics TouchComm Touchscreen Controllers

maintainers:
  - Vsevolod Nevorotov <sevanevorotov29@gmail.com>

description:
  Synaptics TouchComm generation-1 touchscreen controllers. The S3908 is
  connected over I2C. The controller of the Google Pixel 11 phones, whose part
  number is not known, is connected over SPI.

allOf:
  - $ref: touchscreen.yaml#
  - $ref: /schemas/spi/spi-peripheral-props.yaml#

properties:
  compatible:
    enum:
      - syna,s3908
      - syna,tcm

  reg:
    maxItems: 1

  interrupts:
    maxItems: 1

  reset-gpios:
    maxItems: 1

  vdd-supply:
    description: Core / digital power supply regulator (VDD)

  avdd-supply:
    description: Analog power supply regulator (AVDD)

  wakeup-source: true

required:
  - compatible
  - reg
  - interrupts
  - reset-gpios
  - vdd-supply
  - avdd-supply

unevaluatedProperties: false

examples:
  - |
    #include <dt-bindings/interrupt-controller/irq.h>
    #include <dt-bindings/gpio/gpio.h>

    i2c {
        #address-cells = <1>;
        #size-cells = <0>;

        touchscreen@4b {
            compatible = "syna,s3908";
            reg = <0x4b>;
            interrupt-parent = <&tlmm>;
            interrupts = <23 IRQ_TYPE_LEVEL_LOW>;
            reset-gpios = <&tlmm 22 GPIO_ACTIVE_LOW>;
            vdd-supply = <&vreg_l3c_3p0>;
            avdd-supply = <&vreg_l8c_1p8>;
            wakeup-source;
        };
    };
  - |
    #include <dt-bindings/interrupt-controller/irq.h>
    #include <dt-bindings/gpio/gpio.h>

    spi {
        #address-cells = <1>;
        #size-cells = <0>;

        touchscreen@0 {
            compatible = "syna,tcm";
            reg = <0>;
            spi-max-frequency = <19200000>;
            interrupt-parent = <&gpio>;
            interrupts = <12 IRQ_TYPE_LEVEL_LOW>;
            reset-gpios = <&pmic_gpio 17 GPIO_ACTIVE_LOW>;
            vdd-supply = <&vreg_ts_vdd>;
            avdd-supply = <&vreg_ts_avdd>;
        };
    };
```

## Documentation/devicetree/bindings/interrupt-controller/google,lga-gia.yaml
```yaml
# SPDX-License-Identifier: (GPL-2.0-only OR BSD-2-Clause)
%YAML 1.2
---
$id: http://devicetree.org/schemas/interrupt-controller/google,lga-gia.yaml#
$schema: http://devicetree.org/meta-schemas/core.yaml#

title: Google Tensor Generic Interrupt Aggregator (GIA)

maintainers:
  - Witold Olechowski <witusio@gmail.com>

description:
  A Generic Interrupt Aggregator collects up to 32 interrupt lines from a
  subsystem of a Google Tensor SoC and forwards them to its parent interrupt
  controller as a single summary interrupt. Aggregators can be chained, for
  example a pulse aggregator feeding a level aggregator feeding the GIC.

  A level aggregator mirrors the state of its input lines. A pulse aggregator
  latches incoming pulses in status and overflow registers that software
  clears.

properties:
  compatible:
    enum:
      - google,lga-level-gia
      - google,lga-pulse-gia
      - google,mbu-level-gia
      - google,mbu-pulse-gia

  reg:
    maxItems: 1

  interrupts:
    maxItems: 1

  interrupt-controller: true

  '#interrupt-cells':
    const: 1
    description:
      The index of the input line, 0 to 31.

required:
  - compatible
  - reg
  - interrupts
  - interrupt-controller
  - '#interrupt-cells'

additionalProperties: false

examples:
  - |
    #include <dt-bindings/interrupt-controller/arm-gic.h>

    level_gia: interrupt-controller@350d7000 {
        compatible = "google,lga-level-gia";
        reg = <0x350d7000 0x10>;
        interrupts = <GIC_SPI 156 IRQ_TYPE_LEVEL_HIGH>;
        interrupt-controller;
        #interrupt-cells = <1>;
    };

    interrupt-controller@350d1000 {
        compatible = "google,lga-pulse-gia";
        reg = <0x350d1000 0x14>;
        interrupt-parent = <&level_gia>;
        interrupts = <0>;
        interrupt-controller;
        #interrupt-cells = <1>;
    };
```

## Documentation/devicetree/bindings/phy/google,mbu-mipi-dphy.yaml
```yaml
# SPDX-License-Identifier: (GPL-2.0-only OR BSD-2-Clause)
%YAML 1.2
---
$id: http://devicetree.org/schemas/phy/google,mbu-mipi-dphy.yaml#
$schema: http://devicetree.org/meta-schemas/core.yaml#

title: Google Tensor G6 MIPI D-PHY

maintainers:
  - Witold Olechowski <witusio@gmail.com>

description:
  Synopsys DesignWare MIPI C/D-PHY TX (G301) instances used by the DSI
  outputs of the Google Tensor G6 (malibu) SoC, operated in D-PHY mode.

properties:
  compatible:
    const: google,mbu-mipi-dphy

  reg:
    items:
      - description: PHY core registers
      - description: PPI, reset and PLL control registers

  reg-names:
    items:
      - const: core
      - const: apb

  clocks:
    maxItems: 1

  clock-names:
    items:
      - const: pllref

  power-domains:
    maxItems: 1

  '#phy-cells':
    const: 0

required:
  - compatible
  - reg
  - reg-names
  - clocks
  - clock-names
  - '#phy-cells'

additionalProperties: false

examples:
  - |
    phy@f7c0000 {
        compatible = "google,mbu-mipi-dphy";
        reg = <0x0f7c0000 0x18000>, <0x0f7d8800 0x800>;
        reg-names = "core", "apb";
        clocks = <&osc>;
        clock-names = "pllref";
        #phy-cells = <0>;
    };
```

## Documentation/devicetree/bindings/pinctrl/google,mbu-pinctrl.yaml
```yaml
# SPDX-License-Identifier: (GPL-2.0-only OR BSD-2-Clause)
%YAML 1.2
---
$id: http://devicetree.org/schemas/pinctrl/google,mbu-pinctrl.yaml#
$schema: http://devicetree.org/meta-schemas/core.yaml#

title: Google Tensor G6 (malibu) pin controller

maintainers:
  - Witold Olechowski <witusio@gmail.com>

description:
  The Google Tensor G6 SoC has one pin controller per subsystem. Every pin
  has its own register window with mux, pad configuration, GPIO data and
  interrupt registers. Pins that can interrupt the CPU each have their own
  interrupt line, usually to a Generic Interrupt Aggregator.

properties:
  compatible:
    enum:
      - google,mbu-aoss-audio-pinctrl
      - google,mbu-aoss-pinctrl
      - google,mbu-gdmc-pinctrl
      - google,mbu-hsios-pinctrl
      - google,mbu-hsios-stby-pinctrl
      - google,mbu-lsioe-pinctrl
      - google,mbu-lsios-pinctrl
      - google,mbu-pcie-pinctrl

  reg:
    maxItems: 1

  clocks:
    minItems: 1
    maxItems: 4

  power-domains:
    maxItems: 1

  gpio-controller: true

  '#gpio-cells':
    const: 2

  gpio-ranges:
    maxItems: 1

  gpio-reserved-ranges: true

  interrupt-controller: true

  '#interrupt-cells':
    const: 2

  interrupts:
    description:
      One interrupt per pin that can interrupt the CPU.
    minItems: 1
    maxItems: 128

  google,irq-pins:
    $ref: /schemas/types.yaml#/definitions/uint32-array
    description:
      The pin number served by each entry of the interrupts property, in the
      same order.
    minItems: 1
    maxItems: 128

patternProperties:
  '-pins$':
    type: object
    $ref: /schemas/pinctrl/pincfg-node.yaml#
    additionalProperties: false

    properties:
      pins:
        description: Names of the pins to configure.
        minItems: 1
        maxItems: 128

      function:
        description: Mux function to select, e.g. "lsios_uart3".

      bias-disable: true
      bias-pull-down: true
      bias-pull-up: true
      input-enable: true
      input-disable: true
      input-schmitt-enable: true
      input-schmitt-disable: true
      output-enable: true
      output-disable: true
      output-high: true
      output-low: true

      drive-strength:
        minimum: 0
        maximum: 15

      slew-rate:
        enum: [0, 1]

    required:
      - pins

required:
  - compatible
  - reg
  - gpio-controller
  - '#gpio-cells'
  - gpio-ranges

dependencies:
  interrupts: [ 'google,irq-pins', interrupt-controller, '#interrupt-cells' ]

additionalProperties: false

examples:
  - |
    #include <dt-bindings/interrupt-controller/irq.h>

    lsios_pinctrl: pinctrl@3bce0000 {
        compatible = "google,mbu-lsios-pinctrl";
        reg = <0x3bce0000 0x44000>;
        gpio-controller;
        #gpio-cells = <2>;
        gpio-ranges = <&lsios_pinctrl 0 0 68>;
        gpio-reserved-ranges = <51 1>;
        interrupt-controller;
        #interrupt-cells = <2>;
        interrupts-extended = <&lsios_gia 0>, <&lsios_gia 1>;
        google,irq-pins = <2>, <3>;

        uart3-func-pins {
            pins = "XLSIOS_SPIU3_MISO_RXD", "XLSIOS_SPIU3_MOSI_TXD";
            function = "lsios_uart3";
            output-disable;
            input-enable;
        };
    };
```

## Documentation/devicetree/bindings/regulator/ti,tps628600.yaml
```yaml
# SPDX-License-Identifier: (GPL-2.0-only OR BSD-2-Clause)
%YAML 1.2
---
$id: http://devicetree.org/schemas/regulator/ti,tps628600.yaml#
$schema: http://devicetree.org/meta-schemas/core.yaml#

title: TI TPS628600 step-down converter

maintainers:
  - Witold Olechowski <witusio@gmail.com>

description:
  I2C controlled step-down converter with a 0.4 V to 1.9875 V output in
  12.5 mV steps, switched on and off through its enable pin.

allOf:
  - $ref: regulator.yaml#

properties:
  compatible:
    const: ti,tps628600

  reg:
    maxItems: 1

  enable-gpios:
    maxItems: 1

required:
  - compatible
  - reg
  - enable-gpios

unevaluatedProperties: false

examples:
  - |
    #include <dt-bindings/gpio/gpio.h>

    i2c {
        #address-cells = <1>;
        #size-cells = <0>;

        regulator@40 {
            compatible = "ti,tps628600";
            reg = <0x40>;
            enable-gpios = <&pmic_gpio 13 GPIO_ACTIVE_HIGH>;
            regulator-name = "vddd";
            regulator-min-microvolt = <1000000>;
            regulator-max-microvolt = <1000000>;
        };
    };
```
